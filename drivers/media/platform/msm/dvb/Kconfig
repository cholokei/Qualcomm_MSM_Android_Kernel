## drivers/media/platform/msm/dvb/Kconfig
```kconfig
config MSM_DVB
	tristate "Qualcomm DVB Adapter"
	depends on ARCH_MSM && DVB_CORE
	default n

	help
	  Support for Qualcomm based DVB adapter.
	  Say Y or M if you own such a device and want to use it.

source "drivers/media/platform/msm/dvb/demux/Kconfig"
source "drivers/media/platform/msm/dvb/video/Kconfig"
```

## drivers/media/platform/msm/vidc/Kconfig
```kconfig
#
# VIDEO CORE
#

menuconfig MSM_VIDC_V4L2
	bool "Qualcomm MSM V4L2 based video driver"
		depends on ARCH_MSM8974 && MSM_MEDIA && VIDEO_V4L2
        select VIDEOBUF2_CORE
		default y
```

## drivers/media/platform/msm/wfd/Kconfig
```kconfig
menuconfig MSM_WFD
	bool "Qualcomm MSM V4L2 based wifi display driver"
		depends on (MSM_VIDC_1080P || MSM_VIDC_V4L2)
		---help---
		Enables the Wifi Display driver.
```
